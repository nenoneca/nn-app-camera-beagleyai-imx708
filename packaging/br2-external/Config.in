## packaging/br2-external/Config.in
```kconfig
source "$BR2_EXTERNAL_NN_PATH/package/nn-setupd/Config.in"
source "$BR2_EXTERNAL_NN_PATH/package/nn-sysupd/Config.in"
source "$BR2_EXTERNAL_NN_PATH/package/nn-gw/Config.in"
```

## packaging/br2-external/package/nn-gw/Config.in
```kconfig
config BR2_PACKAGE_NN_GW
	bool "nn-gw (camera-hosted Thread gateway: gw_linux + agent)"
	depends on BR2_TOOLCHAIN_HAS_THREADS
	depends on BR2_PACKAGE_SYSTEMD        # sd-bus (BLE backend) + the units
	depends on BR2_USE_MMU
	select BR2_PACKAGE_MBEDTLS            # PSA crypto: identity + hub envelopes
	help
	  gw_linux from nn-modules/host/gw_linux, the same daemon the
	  OrangePi hub runs against its USB NCP, plus a small agent that
	  reports radio presence to the hub, seeds the gateway identity the
	  hub delivered with the camera's provisioning, and starts the
	  daemon when the operator enables the role.  Needs an ESP32-C6
	  running ncp_esp32c6 on USB; without one the agent just reports
	  "no NCP" and nothing else runs.

comment "nn-gw needs systemd and a toolchain w/ threads"
	depends on !BR2_PACKAGE_SYSTEMD || !BR2_TOOLCHAIN_HAS_THREADS
```

## packaging/br2-external/package/nn-setupd/Config.in
```kconfig
config BR2_PACKAGE_NN_SETUPD
	bool "nn-setupd (BLE setup mode)"
	depends on BR2_TOOLCHAIN_HAS_THREADS
	depends on BR2_PACKAGE_SYSTEMD        # sd-bus, for the BlueZ GATT app
	depends on BR2_USE_MMU
	select BR2_PACKAGE_MBEDTLS            # PSA crypto for the ECIES envelope
	select BR2_PACKAGE_BLUEZ5_UTILS       # bluetoothd must own the controller
	select BR2_PACKAGE_IWD                # where the Wi-Fi credentials land
	help
	  Presents the same BLE GATT contract as the ESP cameras
	  (service e7f00001) so the hub's existing provisioning wizard
	  adopts this board with no protocol change, then applies the
	  Wi-Fi credentials through iwd.

	  Runs only while unprovisioned; it exits as soon as the device
	  has been adopted.

comment "nn-setupd needs systemd (sd-bus) and a toolchain w/ threads"
	depends on !BR2_PACKAGE_SYSTEMD || !BR2_TOOLCHAIN_HAS_THREADS

config BR2_PACKAGE_NN_SETUPD_SRCDIR
	string "path to the nn-app-camera-beagleyai-imx708 checkout"
	default "/media/chalos/mx500/beagley-image-build/src/nn-app-byai"
	depends on BR2_PACKAGE_NN_SETUPD
	help
	  Built from a local checkout rather than fetched, so an image can
	  be cut from work in progress.  Point this at a clone of
	  chalos/nn-app-camera-beagleyai-imx708 with its nn-modules
	  submodule initialised.
```

## packaging/br2-external/package/nn-sysupd/Config.in
```kconfig
config BR2_PACKAGE_NN_SYSUPD
	bool "nn-sysupd (whole-system A/B OTA agent)"
	depends on BR2_INIT_SYSTEMD
	select BR2_PACKAGE_LIBCURL
	select BR2_PACKAGE_LIBCURL_CURL
	select BR2_PACKAGE_XZ
	select BR2_PACKAGE_E2FSPROGS
	select BR2_PACKAGE_UBOOT_TOOLS
	select BR2_PACKAGE_UBOOT_TOOLS_FWPRINTENV
	select BR2_PACKAGE_UTIL_LINUX
	select BR2_PACKAGE_UTIL_LINUX_BINARIES   # blkid, blockdev, findmnt, sfdisk
	select BR2_PACKAGE_UTIL_LINUX_SCHEDUTILS # ionice
	help
	  The agent behind the "ab-v1" whole-system OTA: polls the hub for a
	  byai_system rootfs, writes it to the idle root slot, arms a U-Boot
	  trial boot and confirms or rolls it back on health.  Lives in
	  nn-modules tools/nn-sysupd; the image supplies the layout it needs
	  (fw_env.config, /boot-fat, /etc/nn-layout, nn-data).

comment "nn-sysupd needs systemd"
	depends on !BR2_INIT_SYSTEMD
```
